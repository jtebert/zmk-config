## config/boards/shields/hotpaw/Kconfig.defconfig
```kconfig
if SHIELD_HOTPAW_LEFT

config ZMK_KEYBOARD_NAME
    default "Hotpaw"

config ZMK_SPLIT_ROLE_CENTRAL
    default y

endif

if SHIELD_HOTPAW_LEFT || SHIELD_HOTPAW_RIGHT

config ZMK_SPLIT
    default y

endif
```

## config/boards/shields/hotpaw/Kconfig.shield
```kconfig
config SHIELD_HOTPAW_LEFT
    def_bool $(shields_list_contains,hotpaw_left)

config SHIELD_HOTPAW_RIGHT
    def_bool $(shields_list_contains,hotpaw_right)
```
